/**
 * @cliArgs --board "/ti/boards/CC3220SF_LAUNCHXL" --product "simplelink_cc32xx_sdk@4_20_00_07"
 * @versions {"tool":"1.9.0+2015","templates":null}
 */

/**
 * Import the modules used in this configuration.
 */
const ADC    = scripting.addModule("/ti/drivers/ADC", {}, false);
const ADC1   = ADC.addInstance();
const GPIO   = scripting.addModule("/ti/drivers/GPIO");
const GPIO1  = GPIO.addInstance();
const GPIO2  = GPIO.addInstance();
const GPIO3  = GPIO.addInstance();
const GPIO4  = GPIO.addInstance();
const GPIO5  = GPIO.addInstance();
const GPIO6  = GPIO.addInstance();
const GPIO7  = GPIO.addInstance();
const GPIO8  = GPIO.addInstance();
const GPIO9  = GPIO.addInstance();
const GPIO10 = GPIO.addInstance();
const RTOS   = scripting.addModule("/ti/drivers/RTOS");
const Timer  = scripting.addModule("/ti/drivers/Timer");
const Timer1 = Timer.addInstance();
const Timer2 = Timer.addInstance();
const UART   = scripting.addModule("/ti/drivers/UART", {}, false);
const UART1  = UART.addInstance();

/**
 * Write custom configuration values to the imported modules.
 */
ADC1.$name = "CONFIG_ADC_0";

GPIO1.$hardware = system.deviceData.board.components.LED_RED;
GPIO1.$name     = "CONFIG_GPIO_LED_0";

GPIO2.$hardware = system.deviceData.board.components.LED_GREEN;
GPIO2.$name     = "CONFIG_GPIO_LED_1";

GPIO3.$name = "GPIO_0_P03";
GPIO3.mode  = "Output";

GPIO4.$name = "GPIO_1_P05";
GPIO4.mode  = "Output";

GPIO5.$name = "GPIO_2_P06";
GPIO5.mode  = "Output";

GPIO6.$name = "GPIO_3_P07";
GPIO6.mode  = "Output";

GPIO7.$name = "GPIO_4_P08";
GPIO7.mode  = "Output";

GPIO8.$name = "GPIO_5_P18";
GPIO8.mode  = "Output";

GPIO9.$name = "GPIO_6_P21";
GPIO9.mode  = "Output";

GPIO10.mode  = "Output";
GPIO10.$name = "GPIO_7_P50";

const Power          = scripting.addModule("/ti/drivers/Power", {}, false);
Power.parkPins.$name = "ti_drivers_power_PowerCC32XXPins0";

RTOS.name = "FreeRTOS";

Timer1.$name     = "CONFIG_TIMER_0";
Timer1.timerType = "32 Bits";

Timer2.$name         = "CONFIG_TIMER_1";
Timer2.timerType     = "32 Bits";
Timer2.timer.$assign = "Timer2";

UART1.$name     = "CONFIG_UART_0";
UART1.$hardware = system.deviceData.board.components.XDS110UART;

/**
 * Pinmux solution for unlocked pins/peripherals. This ensures that minor changes to the automatic solver in a future
 * version of the tool will not impact the pinmux you originally saw.  These lines can be completely deleted in order to
 * re-solve from scratch.
 */
ADC1.adc.$suggestSolution         = "ADC0";
ADC1.adc.adcPin.$suggestSolution  = "boosterpack.2";
GPIO1.gpioPin.$suggestSolution    = "boosterpack.29";
GPIO2.gpioPin.$suggestSolution    = "boosterpack.10";
GPIO3.gpioPin.$suggestSolution    = "boosterpack.4";
GPIO4.gpioPin.$suggestSolution    = "boosterpack.7";
GPIO5.gpioPin.$suggestSolution    = "boosterpack.14";
GPIO6.gpioPin.$suggestSolution    = "boosterpack.15";
GPIO7.gpioPin.$suggestSolution    = "boosterpack.18";
GPIO8.gpioPin.$suggestSolution    = "boosterpack.19";
GPIO9.gpioPin.$suggestSolution    = "boosterpack.13";
GPIO10.gpioPin.$suggestSolution   = "boosterpack.17";
Timer1.timer.$suggestSolution     = "Timer0";
UART1.uart.$suggestSolution       = "UART0";
UART1.uart.txPin.$suggestSolution = "ball.55";
UART1.uart.rxPin.$suggestSolution = "ball.57";
